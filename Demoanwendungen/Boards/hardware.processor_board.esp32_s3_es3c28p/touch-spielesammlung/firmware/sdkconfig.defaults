## Demoanwendungen/Boards/hardware.processor_board.esp32_s3_es3c28p/touch-spielesammlung/firmware/sdkconfig.defaults
```kconfig
# The ES3C28P touch board is the catalogued 16 MiB variant.  Keep this
# hardware fact in the reproducible ESP-IDF defaults instead of accepting the
# generic devkit's 2 MiB fallback configuration.
CONFIG_ESPTOOLPY_FLASHSIZE_16MB=y
CONFIG_ESPTOOLPY_FLASHSIZE="16MB"
```

## firmware/gernetix-flashbox/sdkconfig.defaults
```kconfig
# Arduino as an ESP-IDF component requires the 1 kHz FreeRTOS tick.
CONFIG_FREERTOS_HZ=1000
CONFIG_MBEDTLS_KEY_EXCHANGE_PSK=y
CONFIG_MBEDTLS_PSK_MODES=y

# FlashBox offers BLE discovery and a local status GATT service alongside WLAN.
CONFIG_BT_ENABLED=y
CONFIG_BT_BLE_ENABLED=y
CONFIG_BT_NIMBLE_ENABLED=y

# This firmware profile uses the accompanying 16 MB partition table.
CONFIG_ESPTOOLPY_FLASHSIZE_16MB=y
CONFIG_ESPTOOLPY_FLASHSIZE="16MB"

# PlatformIO cannot pass its board variant to Arduino's ESP-IDF component.
# Select the S3 variant explicitly for the FlashBox target.
CONFIG_ARDUINO_VARIANT="esp32s3"
```
